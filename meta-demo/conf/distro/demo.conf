## meta-demo/conf/distro/demo.conf
```bitbake
DISTRO = "demo"
DISTRO_NAME = "Yocto RPi4 RAUC Demo"
DISTRO_VERSION = "0.1.0"

DISTRO_FEATURES:append = " systemd pam rauc"
DISTRO_FEATURES_BACKFILL_CONSIDERED += "sysvinit"

VIRTUAL-RUNTIME_init_manager = "systemd"
VIRTUAL-RUNTIME_initscripts = ""
VIRTUAL-RUNTIME_login_manager = "shadow-base"
```

## meta-demo/conf/layer.conf
```bitbake
BBPATH .= ":${LAYERDIR}"

BBFILES += "${LAYERDIR}/recipes-*/*/*.bb \
            ${LAYERDIR}/recipes-*/*/*.bbappend"

BBFILE_COLLECTIONS += "meta-demo"
BBFILE_PATTERN_meta-demo = "^${LAYERDIR}/"
BBFILE_PRIORITY_meta-demo = "7"

LAYERDEPENDS_meta-demo = "core raspberrypi rauc"
LAYERSERIES_COMPAT_meta-demo = "kirkstone"
```

## meta-demo/conf/machine/raspberrypi4-64-demo.conf
```bitbake
require conf/machine/raspberrypi4-64.conf

GPU_MEM = "16"
ENABLE_I2C = "1"
ENABLE_SPI = "1"
ENABLE_UART = "1"

RPI_USE_U_BOOT = "1"
PREFERRED_PROVIDER_virtual/bootloader = "u-boot"

WKS_FILE = "sdimage-dual-raspberrypi.wks.in"
```
